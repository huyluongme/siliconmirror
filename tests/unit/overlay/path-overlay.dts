// SPDX-License-Identifier: GPL-2.0-or-later
// Copyright (C) 2026 Huy Luong Duc

// A fragment whose target-path is missing from the base.

/dts-v1/;
/plugin/;

/ {
	fragment@0 {
		target-path = "/";
		__overlay__ {
			kept;
		};
	};

	fragment@1 {
		target-path = "/soc/nothing";
		__overlay__ {
			status = "okay";
		};
	};
};
