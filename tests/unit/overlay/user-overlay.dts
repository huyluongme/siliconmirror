// SPDX-License-Identifier: GPL-2.0-or-later
// Copyright (C) 2026 Huy Luong Duc

// An overlay that uses the label which rtc-overlay.dts exports.

/dts-v1/;
/plugin/;

/ {
	fragment@0 {
		target = <&rtc>;
		__overlay__ {
			used = "yes";
		};
	};
};
