// SPDX-License-Identifier: GPL-2.0-or-later
// Copyright (C) 2026 Huy Luong Duc

// A fragment that targets what the fragment before it adds, as the
// firmware's seeed-can-fd-hat-v1 does.

/dts-v1/;
/plugin/;

/ {
	fragment@0 {
		target-path = "/soc";
		__overlay__ {
			fresh {
				first;
			};
		};
	};

	fragment@1 {
		target-path = "/soc/fresh";
		__overlay__ {
			second;
		};
	};
};
