// SPDX-License-Identifier: GPL-2.0-or-later
// Copyright (C) 2026 Huy Luong Duc

// An overlay that names a label which the base does not have.

/dts-v1/;
/plugin/;

/ {
	fragment@0 {
		target = <&nowhere>;
		__overlay__ {
			status = "okay";
		};
	};

	__overrides__ {
		x = <&nowhere>,"status";
	};
};
